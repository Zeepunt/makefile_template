## 03-kconfig/basic/configs/default_defconfig
```kconfig
#
# Makefile Template
#

#
# Library Select
#
CONFIG_LIB_ENABLE=y

#
# Library A Configuration
#
CONFIG_LIB_A_ENABLE=y
CONFIG_LIB_A_PACKAGE=y
# end of Library A Configuration

#
# Library B Configuration
#
CONFIG_LIB_B_ENABLE=y
CONFIG_LIB_B_PACKAGE=y
# end of Library B Configuration
# end of Library Select
# end of Makefile Template
```

## 03-kconfig/basic/lib/Kconfig
```kconfig
menu "Library Select"

config LIB_ENABLE
    bool "Libaray Function Enable"
    default y if LIB_A_ENABLE || LIB_B_ENABLE

source "lib/func_a/Kconfig"
source "lib/func_b/Kconfig"

endmenu
```

## 03-kconfig/basic/lib/func_a/Kconfig
```kconfig
menu "Library A Configuration"

config LIB_A_ENABLE
    bool "Enable Function A"
    default n
    help
        Enable this option to include lib A.

config LIB_A_PACKAGE
    bool "Package Function A"
    depends on LIB_A_ENABLE
    default n
    help
        Enable this option to Package Function A as Library A.

endmenu
```

## 03-kconfig/basic/lib/func_b/Kconfig
```kconfig
menu "Library B Configuration"

config LIB_B_ENABLE
    bool "Enable Function B"
    default n
    help
        Enable this option to include lib B.

config LIB_B_PACKAGE
    bool "Package Function B"
    depends on LIB_B_ENABLE
    default n
    help
        Enable this option to Package Function B as Library B.

endmenu
```
